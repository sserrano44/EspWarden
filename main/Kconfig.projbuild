## main/Kconfig.projbuild
```kconfig
menu "ESP32 Remote Signer Configuration"

    config WIFI_SSID
        string "WiFi SSID"
        default "network"
        help
            SSID (network name) for the device to connect to.

    config WIFI_PASSWORD
        string "WiFi Password"
        default "password"
        help
            WiFi password (WPA or WPA2) for the network.

    config AUTH_KEY
        string "Authentication Key (hex)"
        default ""
        help
            256-bit authentication key in hexadecimal format (64 characters).
            Leave empty to require configuration through provisioning API.

endmenu
```

## sdkconfig.defaults
```kconfig
# ESP32 Remote Signer - Base Configuration
# Common settings for all build configurations

# Target
CONFIG_IDF_TARGET="esp32"

# Security features - DISABLED by default
# Individual build configs can override these
CONFIG_SECURE_BOOT=n
CONFIG_SECURE_FLASH_ENC_ENABLED=n
CONFIG_NVS_ENCRYPTION=n

# Partition Table - Standard offset (no secure boot)
CONFIG_PARTITION_TABLE_CUSTOM=y
CONFIG_PARTITION_TABLE_CUSTOM_FILENAME="partitions.csv"
CONFIG_PARTITION_TABLE_OFFSET=0x8000

# Serial flasher config
CONFIG_ESPTOOLPY_FLASHMODE_DIO=y
CONFIG_ESPTOOLPY_FLASHFREQ_40M=y
CONFIG_ESPTOOLPY_FLASHSIZE_4MB=y
CONFIG_ESPTOOLPY_FLASHSIZE_DETECT=y

# ESP32-specific
CONFIG_ESP32_DEFAULT_CPU_FREQ_240=y
CONFIG_ESP32_SPIRAM_SUPPORT=n

# WiFi
CONFIG_ESP32_WIFI_STATIC_RX_BUFFER_NUM=10
CONFIG_ESP32_WIFI_DYNAMIC_RX_BUFFER_NUM=32
CONFIG_ESP32_WIFI_STATIC_TX_BUFFER=y
CONFIG_ESP32_WIFI_TX_BUFFER_TYPE=1
CONFIG_ESP32_WIFI_STATIC_TX_BUFFER_NUM=16
CONFIG_ESP32_WIFI_NVS_ENABLED=y

# HTTP Server
CONFIG_HTTPD_MAX_REQ_HDR_LEN=1024
CONFIG_HTTPD_MAX_URI_LEN=512

# mbedTLS
CONFIG_MBEDTLS_CERTIFICATE_BUNDLE=y
CONFIG_MBEDTLS_CERTIFICATE_BUNDLE_DEFAULT_FULL=y
CONFIG_MBEDTLS_SSL_VARIABLE_BUFFER_LENGTH=y

# Crypto support for signing
CONFIG_MBEDTLS_ECDSA_C=y
CONFIG_MBEDTLS_ECDH_C=y
CONFIG_MBEDTLS_ECP_C=y
CONFIG_MBEDTLS_BIGNUM_C=y
CONFIG_MBEDTLS_ECP_DP_SECP256K1_ENABLED=y

# FreeRTOS
CONFIG_FREERTOS_HZ=100

# Logging
CONFIG_LOG_DEFAULT_LEVEL_INFO=y
CONFIG_LOG_COLORS=y

# ESP System Settings
CONFIG_ESP_SYSTEM_PANIC_PRINT_REBOOT=y

# Watchdog Timers
CONFIG_ESP_TASK_WDT=y
CONFIG_ESP_TASK_WDT_TIMEOUT_S=5
CONFIG_ESP_INT_WDT=y
CONFIG_ESP_INT_WDT_TIMEOUT_MS=300# ESP32 Remote Signer - Development Configuration
# Inherits from base configuration with development-specific overrides

# Note: Base config has secure boot DISABLED by default
# Development builds do NOT use secure boot for easier debugging

# Development logging (override base)
CONFIG_LOG_DEFAULT_LEVEL_DEBUG=y
CONFIG_LOG_MAXIMUM_LEVEL_DEBUG=y
CONFIG_LOG_COLORS=y

# Development monitoring
CONFIG_ESP_SYSTEM_PANIC_PRINT_HALT=y
CONFIG_ESP_DEBUG_OCDAWARE=y

# Bootloader debugging
CONFIG_BOOTLOADER_LOG_LEVEL_DEBUG=y

# Allow JTAG for debugging
CONFIG_ESP32_DEBUG_OCDAWARE=y

# Disable optimizations for better debugging
CONFIG_COMPILER_OPTIMIZATION_DEFAULT=y
CONFIG_COMPILER_OPTIMIZATION_ASSERTIONS_ENABLE=y

# Enable various debug features
CONFIG_FREERTOS_WATCHPOINT_END_OF_STACK=y
CONFIG_FREERTOS_INTERRUPT_BACKTRACE=y
CONFIG_HEAP_POISONING_LIGHT=y
CONFIG_HEAP_TRACING_OFF=y

# Task watchdog for development
CONFIG_ESP_TASK_WDT_PANIC=y
```

## sdkconfig.defaults.base
```kconfig
# ESP32 Remote Signer - Base Configuration
# Common settings for all build configurations

# Target
CONFIG_IDF_TARGET="esp32"

# Security features - DISABLED by default
# Individual build configs can override these
CONFIG_SECURE_BOOT=n
CONFIG_SECURE_FLASH_ENC_ENABLED=n
CONFIG_NVS_ENCRYPTION=n

# Partition Table - Standard offset (no secure boot)
CONFIG_PARTITION_TABLE_CUSTOM=y
CONFIG_PARTITION_TABLE_CUSTOM_FILENAME="partitions.csv"
CONFIG_PARTITION_TABLE_OFFSET=0x8000

# Serial flasher config
CONFIG_ESPTOOLPY_FLASHMODE_DIO=y
CONFIG_ESPTOOLPY_FLASHFREQ_40M=y
CONFIG_ESPTOOLPY_FLASHSIZE_4MB=y
CONFIG_ESPTOOLPY_FLASHSIZE_DETECT=y

# ESP32-specific
CONFIG_ESP32_DEFAULT_CPU_FREQ_240=y
CONFIG_ESP32_SPIRAM_SUPPORT=n

# WiFi
CONFIG_ESP32_WIFI_STATIC_RX_BUFFER_NUM=10
CONFIG_ESP32_WIFI_DYNAMIC_RX_BUFFER_NUM=32
CONFIG_ESP32_WIFI_STATIC_TX_BUFFER=y
CONFIG_ESP32_WIFI_TX_BUFFER_TYPE=1
CONFIG_ESP32_WIFI_STATIC_TX_BUFFER_NUM=16
CONFIG_ESP32_WIFI_NVS_ENABLED=y

# HTTP Server
CONFIG_HTTPD_MAX_REQ_HDR_LEN=1024
CONFIG_HTTPD_MAX_URI_LEN=512

# mbedTLS
CONFIG_MBEDTLS_CERTIFICATE_BUNDLE=y
CONFIG_MBEDTLS_CERTIFICATE_BUNDLE_DEFAULT_FULL=y
CONFIG_MBEDTLS_SSL_VARIABLE_BUFFER_LENGTH=y

# Crypto support for signing
CONFIG_MBEDTLS_ECDSA_C=y
CONFIG_MBEDTLS_ECDH_C=y
CONFIG_MBEDTLS_ECP_C=y
CONFIG_MBEDTLS_BIGNUM_C=y
CONFIG_MBEDTLS_ECP_DP_SECP256K1_ENABLED=y

# FreeRTOS
CONFIG_FREERTOS_HZ=100

# Logging
CONFIG_LOG_DEFAULT_LEVEL_INFO=y
CONFIG_LOG_COLORS=y

# ESP System Settings
CONFIG_ESP_SYSTEM_PANIC_PRINT_REBOOT=y

# Watchdog Timers
CONFIG_ESP_TASK_WDT=y
CONFIG_ESP_TASK_WDT_TIMEOUT_S=5
CONFIG_ESP_INT_WDT=y
CONFIG_ESP_INT_WDT_TIMEOUT_MS=300
```

## sdkconfig.defaults.dev
```kconfig
# ESP32 Remote Signer - Development Configuration
# Inherits from base configuration with development-specific overrides

# Note: Base config has secure boot DISABLED by default
# Development builds do NOT use secure boot for easier debugging

# Development logging (override base)
CONFIG_LOG_DEFAULT_LEVEL_DEBUG=y
CONFIG_LOG_MAXIMUM_LEVEL_DEBUG=y
CONFIG_LOG_COLORS=y

# Development monitoring
CONFIG_ESP_SYSTEM_PANIC_PRINT_HALT=y
CONFIG_ESP_DEBUG_OCDAWARE=y

# Bootloader debugging
CONFIG_BOOTLOADER_LOG_LEVEL_DEBUG=y

# Allow JTAG for debugging
CONFIG_ESP32_DEBUG_OCDAWARE=y

# Disable optimizations for better debugging
CONFIG_COMPILER_OPTIMIZATION_DEFAULT=y
CONFIG_COMPILER_OPTIMIZATION_ASSERTIONS_ENABLE=y

# Enable various debug features
CONFIG_FREERTOS_WATCHPOINT_END_OF_STACK=y
CONFIG_FREERTOS_INTERRUPT_BACKTRACE=y
CONFIG_HEAP_POISONING_LIGHT=y
CONFIG_HEAP_TRACING_OFF=y

# Task watchdog for development
CONFIG_ESP_TASK_WDT_PANIC=y
```

## sdkconfig.defaults.prod
```kconfig
# ESP32 Remote Signer - Production Configuration
# Inherits from base configuration with production-specific overrides
# ENABLES SECURE BOOT FOR PRODUCTION USE

# Security features - ENABLED for production (overrides base config)
CONFIG_SECURE_BOOT=y
CONFIG_SECURE_BOOT_V2_ENABLED=y
CONFIG_SECURE_FLASH_ENC_ENABLED=y
CONFIG_SECURE_FLASH_ENCRYPTION_MODE_RELEASE=y
CONFIG_SECURE_BOOT_ALLOW_ROM_BASIC=n
CONFIG_SECURE_BOOT_ALLOW_JTAG=n  # Disabled for production
CONFIG_NVS_ENCRYPTION=y

# Partition table offset - Extended for secure boot bootloader
CONFIG_PARTITION_TABLE_OFFSET=0x10000
CONFIG_PARTITION_TABLE_CUSTOM_FILENAME="partitions_secure.csv"

# Flash encryption - release mode
CONFIG_SECURE_FLASH_REQUIRE_ALREADY_ENABLED=y
CONFIG_SECURE_FLASH_ENCRYPTION_AES256=y

# Release optimizations
CONFIG_COMPILER_OPTIMIZATION_SIZE=y
CONFIG_COMPILER_OPTIMIZATION_ASSERTIONS_DISABLE=y

# Production logging (minimal)
CONFIG_LOG_DEFAULT_LEVEL_WARN=y
CONFIG_LOG_COLORS=n

# Production monitoring
CONFIG_ESP_SYSTEM_PANIC_SILENT_REBOOT=y
CONFIG_ESP_DEBUG_OCDAWARE=n
CONFIG_ESP32_DEBUG_OCDAWARE=n

# Bootloader
CONFIG_BOOTLOADER_LOG_LEVEL_ERROR=y
CONFIG_BOOTLOADER_SKIP_VALIDATE_IN_DEEP_SLEEP=y

# Disable debugging features for production
CONFIG_ESP_ERR_TO_NAME_LOOKUP=n
CONFIG_FREERTOS_WATCHPOINT_END_OF_STACK=n
CONFIG_HEAP_POISONING_DISABLED=y
```
